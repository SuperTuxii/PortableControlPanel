## firmware/sdkconfig.defaults
```kconfig
CONFIG_LV_CONF_SKIP=y
CONFIG_LV_COLOR_DEPTH_16=y
CONFIG_LV_USE_OBSERVER=y
CONFIG_LV_USE_DRAW_SW_COMPLEX_GRADIENTS=y
CONFIG_IDF_EXPERIMENTAL_FEATURES=y

CONFIG_TINYUSB_CDC_ENABLED=y
```

## firmware/sdkconfig.defaults.esp32p4
```kconfig
CONFIG_ESP32P4_SELECTS_REV_LESS_V3=y
CONFIG_ESP32P4_REV_MIN_100=y

CONFIG_SPI_FLASH_SUPPORT_BOYA_CHIP=y
CONFIG_SPIRAM=y
CONFIG_SPIRAM_MODE_HEX=y
CONFIG_SPIRAM_SPEED_200M=y
```
